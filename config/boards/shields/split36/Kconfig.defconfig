## config/boards/shields/split36/Kconfig.defconfig
```kconfig
if SHIELD_SPLIT36_LEFT
config ZMK_KEYBOARD_NAME
    default "split36"

config ZMK_SPLIT_ROLE_CENTRAL
    default y
endif # LEFT



if SHIELD_SPLIT36_LEFT || SHIELD_SPLIT36_RIGHT

config ZMK_SPLIT
    default y

endif # LEFT OR RIGHT
```

## config/boards/shields/split36/Kconfig.shield
```kconfig
config SHIELD_SPLIT36_LEFT
    def_bool $(shields_list_contains,split36_left)

config SHIELD_SPLIT36_RIGHT
    def_bool $(shields_list_contains,split36_right)
```
